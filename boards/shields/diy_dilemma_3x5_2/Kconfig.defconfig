## boards/shields/diy_dilemma_3x5_2/Kconfig.defconfig
```kconfig
# Kconfig.defconfig
if SHIELD_DIY_DILEMMA_3X5_2_LEFT

config ZMK_KEYBOARD_NAME
    default "Dilemma DIY"

config ZMK_SPLIT_ROLE_CENTRAL
    default y

endif

if SHIELD_DIY_DILEMMA_3X5_2_LEFT || SHIELD_DIY_DILEMMA_3X5_2_RIGHT

config ZMK_SPLIT
    default y

if ZMK_DISPLAY

config SPI
    default y

config IL0323
    default y

config ZMK_DISPLAY_BLANK_ON_IDLE
    default y

endif # ZMK_DISPLAY

endif
```

## boards/shields/diy_dilemma_3x5_2/Kconfig.shield
```kconfig
# Kconfig.shield - Shield configuration

config SHIELD_DIY_DILEMMA_3X5_2_LEFT
    def_bool $(shields_list_contains,diy_dilemma_3x5_2_left)

config SHIELD_DIY_DILEMMA_3X5_2_RIGHT
    def_bool $(shields_list_contains,diy_dilemma_3x5_2_right)
```
